//    This file is part of RTCMinHeartBeat library.
//
//    The Arduino RTCMinHeartBeat library is intended for any Arduino board.
//	  It allows to get a minute cadenced heartbeat generated by a D3231 Real Time Clock (RTC).
//	  The minute heartbeat is implemented using D3231 alarm2 to trigger an interrupt signal.
//    The library allows usual RTC functions (get/set RTC time&date) as well.
//
//    Hardware Requisite :
//    - Any Arduino board
//	  - A D3231 Real Time Clock (RTC) module, with a 10k Ohm resistor placed between INT and VCC pins
//    - D3231 power (vcc/gnd pins) and I2C bus (sda/scl pins) conected to the Arduino
//    - D3231 INT/SQW pin connected to Arduino pin 2 (or any pin usable for interrupts, check your Arduino board hardware)
//
//    Copyright (C) 2016 Franck MARINI (fm@liwan.fr)
//
//    The Arduino RTCMinHeartBeat library is free software: you can redistribute it and/or modify
//    it under the terms of the GNU General Public License as published by
//    the Free Software Foundation, either version 3 of the License, or
//    (at your option) any later version.

//    This program is distributed in the hope that it will be useful,
//    but WITHOUT ANY WARRANTY; without even the implied warranty of
//    MERCHANTABILITY or FITNESS FOR A PARTICULAR PURPOSE.  See the
//    GNU General Public License for more details.

//    You should have received a copy of the GNU General Public License
//    along with this program.  If not, see <http://www.gnu.org/licenses/>.

// File : RTCMinHeartBeat.cpp
// Author : Franck Marini
// Module dependencies : Wire, String

#include "RTCMinHeartBeat.h"

// RTCMinHeartBeat unique instance creation
RTCMinHeartBeat RTCMinHeartBeat::_rtc;
RTCMinHeartBeat& rtc = RTCMinHeartBeat::_rtc;

const String TimeDate::_dayString[]= {"Null","Sunday","Monday","Tuesday","Wednesday","Thursday","Friday","Saturday"};

static byte Alarm2SettingsVal[] = {
      0x80, //  Alarm 2 Seconds (0Bh) A2M2 = 1;
      0x80, //  Alarm 2 Minutes (0Ch) A2M3 = 1;
      0x81, //  Alarm 2 Hours   (0Dh) A2M4 = 1;
      0x1E, //  Ctrl Register   (0Eh) A2IE = 1; Reg init value = 0x1C
      0x00, //  Status Register (0Fh) reset everything to 0
};


byte RTCMinHeartBeat::configPin(int pin)
{
	pinMode(pin, INPUT_PULLUP);
	attachInterrupt(digitalPinToInterrupt(pin), RTCMinHeartBeatISR , FALLING);
	
	return writeRTC(0x0B, Alarm2SettingsVal ,5); // set Alarm 2 with a ring each minute
}


void RTCMinHeartBeat::RTCMinHeartBeatISR(){
	rtc._beat = true;
}


void RTCMinHeartBeat::clearHeartBeat()
{
	writeRTC(0x0F, Alarm2SettingsVal+4 ,1); // clear Alarm 2 Status Register
	_beat = false;
}


byte RTCMinHeartBeat::readRTC(byte addr, byte *values, byte nBytes) {
    Wire.beginTransmission(D3231_RTC_BASE_ADDR);
    Wire.write(addr);
    if ( byte e = Wire.endTransmission() ) return e;
    Wire.requestFrom( (uint8_t)D3231_RTC_BASE_ADDR, nBytes );
    for (byte i=0; i<nBytes; i++) values[i] = Wire.read();
    return RTCMINHEARTBEAT_SUCCESS;
}


byte RTCMinHeartBeat::read(TimeDate& td){
    Wire.beginTransmission(D3231_RTC_BASE_ADDR);
    Wire.write(0x00);
    if ( byte retVal = Wire.endTransmission() ) return retVal;
    Wire.requestFrom(D3231_RTC_BASE_ADDR, 7);
    td.sec = bcd2dec(Wire.read());
    td.min = bcd2dec(Wire.read());
    td.hour = bcd2dec(Wire.read() & (byte)0x3F );
    td.day = Wire.read();
    td.date = bcd2dec(Wire.read());
    td.month = bcd2dec(Wire.read() & (byte)0x1F );
    td.year = bcd2dec(Wire.read()) + 2000;
    return RTCMINHEARTBEAT_SUCCESS;
}


byte RTCMinHeartBeat::set(TimeDate& td){
    Wire.beginTransmission(D3231_RTC_BASE_ADDR);
    Wire.write((byte)0x00);
	Wire.write(dec2bcd(td.sec));
	Wire.write(dec2bcd(td.min));
	Wire.write(dec2bcd(td.hour));
	Wire.write(dec2bcd(td.day));
	Wire.write(dec2bcd(td.date));
	Wire.write(dec2bcd(td.month));
	Wire.write(dec2bcd( (byte)(td.year - 2000) ));
	return Wire.endTransmission();
}


byte RTCMinHeartBeat::writeRTC(byte addr, byte *values, byte nBytes) {
    Wire.beginTransmission(D3231_RTC_BASE_ADDR);
    Wire.write(addr);
    for (byte i=0; i<nBytes; i++) Wire.write(values[i]);
    return Wire.endTransmission();
}

// EOF